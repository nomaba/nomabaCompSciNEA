#include <DFRobotDFPlayerMini.h>
#include "IRremote.h"
#include <LedControl.h>
#include "SR04.h"

// //////////////////////////////////////////////////////////////////////////////////////////////////////////////////////////////////////////////////////////////////////////////////////////////////////////////
// notes:
// * get a local version of dfrobotdfplayermini and ledControl
// 
// //////////////////////////////////////////////////////////////////////////////////////////////////////////////////////////////////////////////////////////////////////////////////////////////////////////////



// ////////////////////////////////////////////////////////////////////////////////////////////////////
// ////////////////////////////////////////////////////////////////////////////////////////////////////
// ////////////////////////////////////////////////////////////////////////////////////////////////////
// ////////////////////////////////////////////////////////////////////////////////////////////////////
// ////////////////////////////////////////////////////////////////////////////////////////////////////

// Frames for the MAX7219 LED Dot Matrix Module
// Stored in consts so that the frames can be stored in FLASH memory instead of the SRAM memory 

const uint8_t LOADING[][8] = {
{
  0b11111100,0b11111100,0b00000000,0b00000000,0b00000000,0b00000000,0b00000000,0b00000000
},{
  0b00111111,0b00111111,0b00000000,0b00000000,0b00000000,0b00000000,0b00000000,0b00000000
},{
  0b00001111,0b00001111,0b00000011,0b00000011,0b00000000,0b00000000,0b00000000,0b00000000
},{
  0b00000011,0b00000011,0b00000011,0b00000011,0b00000011,0b00000011,0b00000000,0b00000000
},{
  0b00000000,0b00000000,0b00000011,0b00000011,0b00000011,0b00000011,0b00000011,0b00000011
},{
  0b00000000,0b00000000,0b00000000,0b00000000,0b00000011,0b00000011,0b00001111,0b00001111
},{
  0b00000000,0b00000000,0b00000000,0b00000000,0b00000011,0b00000011,0b00111111,0b00111111
},{
  0b00000000,0b00000000,0b00000000,0b00000000,0b00000000,0b00000000,0b11111100,0b11111100
},{
  0b00000000,0b00000000,0b00000000,0b00000000,0b11000000,0b11000000,0b11110000,0b11110000
},{
  0b00000000,0b00000000,0b11000000,0b11000000,0b11000000,0b11000000,0b11000000,0b11000000
},{
  0b11000000,0b11000000,0b11000000,0b11000000,0b11000000,0b11000000,0b00000000,0b00000000
},{
  0b11110000,0b11110000,0b11000000,0b11000000,0b00000000,0b00000000,0b00000000,0b00000000
}};
const int framesNumLoading = sizeof(LOADING) / sizeof(LOADING[0]);

//
//
//
//
//

const uint8_t SMILE[][8] = {
{
  0b00000000,0b00000000,0b00100100,0b00100100,0b00000000,0b01000010,0b00111100,0b00000000
}};
const int frameNumSmile = sizeof(SMILE);


// ////////////////////////////////////////////////////////////////////////////////////////////////////
// ////////////////////////////////////////////////////////////////////////////////////////////////////
// ////////////////////////////////////////////////////////////////////////////////////////////////////
// ////////////////////////////////////////////////////////////////////////////////////////////////////
// ////////////////////////////////////////////////////////////////////////////////////////////////////

// PIN variables and other variables and some code for components

String previousButtonPress = "null";
String command = "null";


//
//
//
//
//

// Motor Driver L298N
// Motor A (Left)
const int ENA = 53;
const int IN1 = 51;
const int IN2 = 49;
// Motor B (Right)
const int IN3 = 47;
const int IN4 = 45;
const int ENB = 43;

//
//
//
//
//

// HC-05 bluetooth module
// HIGH = Bluetooth connected and serial port active
const int statePin = 41;

//
//
//
//
//

// MAX7219 LED Dot Matrix Module
LedControl lc = LedControl(48, 52, 50, 1); // Created variable called ledMatrix that contains the location of the pins for the module // LedControl(DIN pin, CLK pin, CS pin, number of matrixes);)

//
//
//
//
//

// IR Receiver
int receiver = 46;
// Declare objects
IRrecv irrecv(receiver);     // create instance of 'irrecv'
decode_results results;      // create instance of 'decode_results'

//
//
//
//
//

// LEDs
const int onboardLedPin = 13; //LED L on the arduino board

//
//
//
//
//

// DFPlayer Mini MP3 Module
DFRobotDFPlayerMini player; // create the df player object

//
//
//
//
//

// SR04 Ultrasonic Distance Sensor Module
#define TRIG_PIN 42 //Ultrasonic Distance Sensor TRIG connected at PIN 42
#define ECHO_PIN 44 //Ultrasonic Distance Sensor ECHO connected at PIN 44
SR04 sr04 = SR04(ECHO_PIN, TRIG_PIN); // created variable called "sr04" that stores the location of the pins connected to the SR04 Ultrasonic Distance Sensor module
long distanceFront = 0; // variable that holds numbers of max size 4 bytes
void getDistanceFront()
{
    distanceFront = sr04.Distance();
}

//
//
//
//
//

// ////////////////////////////////////////////////////////////////////////////////////////////////////
// ////////////////////////////////////////////////////////////////////////////////////////////////////
// ////////////////////////////////////////////////////////////////////////////////////////////////////
// ////////////////////////////////////////////////////////////////////////////////////////////////////
// ////////////////////////////////////////////////////////////////////////////////////////////////////
// ////////////////////////////////////////////////////////////////////////////////////////////////////
// ////////////////////////////////////////////////////////////////////////////////////////////////////
// ////////////////////////////////////////////////////////////////////////////////////////////////////
// ////////////////////////////////////////////////////////////////////////////////////////////////////
// ////////////////////////////////////////////////////////////////////////////////////////////////////
// ////////////////////////////////////////////////////////////////////////////////////////////////////
// ////////////////////////////////////////////////////////////////////////////////////////////////////
// ////////////////////////////////////////////////////////////////////////////////////////////////////
// ////////////////////////////////////////////////////////////////////////////////////////////////////
// ////////////////////////////////////////////////////////////////////////////////////////////////////

void setup() 
{
  delay(2000); // This is here so that everything has time to start up properly

  irrecv.enableIRIn(); // Activate the IR sensor

  Serial.begin(9600);
  Serial1.begin(9600); // Start the serial communication with the HC-05 Module at speed 9600 baud
  Serial2.begin(9600); // Start the serial communication with the DFPlayerMini at speed 9600 baud

  //
  //
  //
  //
  //

  
  lc.shutdown(0, false); // Wake up the MAX7219 from power-saving mode
  lc.setIntensity(0, 0); // Set brightness level (0 is min, 15 is max)
  lc.clearDisplay(0); // Clear the display (turn off all LEDs)
  
  //
  //
  //
  //
  //

  // Start communication with DFPlayer Mini
  if (player.begin(Serial2)) {
    Serial.println("OK");

    // Set volume to maximum (0 to 30).
    player.volume(30);
    // Play the "0001.mp3" in the "mp3" folder on the SD card
    player.playMp3Folder(3); // spongebon

  } else {
    Serial.println("Connecting to DFPlayer Mini failed!");
  }

  pinMode(statePin, INPUT);

  // Set motor control pins as output
  pinMode(ENA, OUTPUT);
  pinMode(IN1, OUTPUT);
  pinMode(IN2, OUTPUT);
  pinMode(IN3, OUTPUT);
  pinMode(IN4, OUTPUT);
  pinMode(ENB, OUTPUT);

  // Set onboardLedPin as output
  pinMode(onboardLedPin, OUTPUT);

  //
  //
  //

  // Set speed using PWM (0-255)
  analogWrite(ENA, 255);  // Full speed left motor
  analogWrite(ENB, 255);  // Full speed right motor

  stopMotors(); // This is here just to make sure

  digitalWrite(onboardLedPin, LOW);

  //
  //
  //

  Serial.println("ready");

  delay(1000); // This is here just cus

  while (digitalRead(statePin) == LOW)
  {
    for (int i = 0; i < framesNumLoading; i++) {
    drawFrame(LOADING[i]);
    delay(100); // adjust speed here (100ms per frame)
  }
  }

  drawFrame(SMILE[0]);

  player.playMp3Folder(4); //The bluetooth device is coneccted successfully
}

// ////////////////////////////////////////////////////////////////////////////////////////////////////
// ////////////////////////////////////////////////////////////////////////////////////////////////////
// ////////////////////////////////////////////////////////////////////////////////////////////////////
// ////////////////////////////////////////////////////////////////////////////////////////////////////
// ////////////////////////////////////////////////////////////////////////////////////////////////////
// ////////////////////////////////////////////////////////////////////////////////////////////////////
// ////////////////////////////////////////////////////////////////////////////////////////////////////
// ////////////////////////////////////////////////////////////////////////////////////////////////////
// ////////////////////////////////////////////////////////////////////////////////////////////////////
// ////////////////////////////////////////////////////////////////////////////////////////////////////
// ////////////////////////////////////////////////////////////////////////////////////////////////////
// ////////////////////////////////////////////////////////////////////////////////////////////////////
// ////////////////////////////////////////////////////////////////////////////////////////////////////
// ////////////////////////////////////////////////////////////////////////////////////////////////////
// ////////////////////////////////////////////////////////////////////////////////////////////////////

void loop() 
{
  if (irrecv.decode(&results)) // have we received an IR signal?
  {
    translateIR(); 
    irrecv.resume(); // receive the next value
    delay(600);
  }
  else{
    //delay(50);
    stopMotors();
  }

  //
  //
  //

  if (Serial1.available()) // checks if the computer has sent anything to the arduino through the serialMonitor
  {
    command = Serial1.readStringUntil('\n'); //set the variable command to whatever was sent through the serialPort
    command.trim(); // removes unneccecary things from the message (\r, \n)

    //translateSerial();

    if (command == "forward") 
    {
        Serial1.println("moving forwards");
        moveForward();
        delay(500);

    } else if (command == "backward") 
    {
        Serial1.println("moving backwards");
        moveBackward();
        delay(500);

    } else if (command == "right")
    {
        Serial1.println("turning right");
        turnRight();
        delay(500);

    } else if (command == "left")
    {
        Serial1.println("turning left");
        turnLeft();
        delay(500);
    } 
  } else
  {
    delay(500); //millis(); might be a better alternative because the arduino can check for things sent in the serial port while it waits [ask GPT for the difference between delay and millis]
    //The arduino might miss the data sent from the computer if delay is used
  }
}

// ////////////////////////////////////////////////////////////////////////////////////////////////////
// ////////////////////////////////////////////////////////////////////////////////////////////////////
// ////////////////////////////////////////////////////////////////////////////////////////////////////
// ////////////////////////////////////////////////////////////////////////////////////////////////////
// ////////////////////////////////////////////////////////////////////////////////////////////////////
// ////////////////////////////////////////////////////////////////////////////////////////////////////
// ////////////////////////////////////////////////////////////////////////////////////////////////////
// ////////////////////////////////////////////////////////////////////////////////////////////////////
// ////////////////////////////////////////////////////////////////////////////////////////////////////
// ////////////////////////////////////////////////////////////////////////////////////////////////////
// ////////////////////////////////////////////////////////////////////////////////////////////////////
// ////////////////////////////////////////////////////////////////////////////////////////////////////
// ////////////////////////////////////////////////////////////////////////////////////////////////////
// ////////////////////////////////////////////////////////////////////////////////////////////////////
// ////////////////////////////////////////////////////////////////////////////////////////////////////

void translateSerial1()
{
  if (command == "forwards")
  {
    moveForward();
  }
  else if (command == "backwards")
  {
    moveBackward();
  }
  else if (command == "left")
  {
    turnLeft();
  }
  else if (command == "right")
  {
    turnRight();
  }
  else if (command == "stop")
  {
    stopMotors();
  }
}

// ////////////////////////////////////////////////////////////////////////////////////////////////////
// ////////////////////////////////////////////////////////////////////////////////////////////////////
// ////////////////////////////////////////////////////////////////////////////////////////////////////
// ////////////////////////////////////////////////////////////////////////////////////////////////////
// ////////////////////////////////////////////////////////////////////////////////////////////////////

void translateIR() // takes action based on IR code received
// describing Remote IR codes 
{
  switch(results.value)
  {
    case 0xFF629D: Serial.println("VOL+"); moveForward(); previousButtonPress = "VOL+"; break;
    case 0xFF22DD: Serial.println("FAST BACK"); turnLeft(); previousButtonPress = "FAST BACK"; break;
    case 0xFFC23D: Serial.println("FAST FORWARD"); turnRight(); previousButtonPress = "FAST FORWARD"; break;
    case 0xFFE01F: Serial.println("DOWN"); moveBackward(); previousButtonPress = "DOWN"; break;
    case 0xFFA857: Serial.println("VOL-"); moveBackward(); previousButtonPress = "VOL-"; break;
    case 0xFF906F: Serial.println("UP"); moveForward(); previousButtonPress = "UP"; break;
    case 0xFFFFFFFF: Serial.println(" REPEAT");
      if (previousButtonPress == "VOL+"){
        moveForward();
      }
      else if (previousButtonPress == "FAST BACK"){
        turnLeft();
      }
      else if (previousButtonPress == "FAST FORWARD"){
        turnRight();
      }
      else if (previousButtonPress == "DOWN"){
        moveBackward();
      }
      else if (previousButtonPress == "VOL-"){
        moveBackward();
      }
      else if (previousButtonPress == "UP"){
        moveForward();
      }
    break;  
  default: 
    stopMotors();
  }

  //delay(100); // Do not get immediate repeat
}

// ////////////////////////////////////////////////////////////////////////////////////////////////////
// ////////////////////////////////////////////////////////////////////////////////////////////////////
// ////////////////////////////////////////////////////////////////////////////////////////////////////
// ////////////////////////////////////////////////////////////////////////////////////////////////////
// ////////////////////////////////////////////////////////////////////////////////////////////////////

// The next few subroutines control the movement of the robot
void moveForward() {
  digitalWrite(IN1, LOW);
  digitalWrite(IN2, HIGH);
  digitalWrite(IN3, LOW);
  digitalWrite(IN4, HIGH);
}
void moveBackward() {
  digitalWrite(IN1, HIGH);
  digitalWrite(IN2, LOW);
  digitalWrite(IN3, HIGH);
  digitalWrite(IN4, LOW);
}
void turnLeft() {
  digitalWrite(IN1, LOW);
  digitalWrite(IN2, HIGH);
  digitalWrite(IN3, LOW);
  digitalWrite(IN4, LOW);
}
void turnRight() {
  digitalWrite(IN1, LOW);
  digitalWrite(IN2, LOW);
  digitalWrite(IN3, LOW);
  digitalWrite(IN4, HIGH);
}
void stopMotors() {
  digitalWrite(IN1, LOW);
  digitalWrite(IN2, LOW);
  digitalWrite(IN3, LOW);
  digitalWrite(IN4, LOW);
}

// ////////////////////////////////////////////////////////////////////////////////////////////////////
// ////////////////////////////////////////////////////////////////////////////////////////////////////
// ////////////////////////////////////////////////////////////////////////////////////////////////////
// ////////////////////////////////////////////////////////////////////////////////////////////////////
// ////////////////////////////////////////////////////////////////////////////////////////////////////

void drawFrame(const uint8_t frame[8]) {
  for (int row = 0; row < 8; row++) {
    lc.setRow(0, row, frame[row]);
  }
}

